## boards/shields/totem-dongle/Kconfig.defconfig
```kconfig
# Copyright (c) 2022 The ZMK Contributors
# SPDX-License-Identifier: MIT

config ZMK_SPLIT
    default y

config ZMK_BLE
    default y

if SHIELD_TOTEM_DONGLE || SHIELD_TOTEM_DONGLE_PROSPECTOR || SHIELD_TOTEM_DONGLE_DISPLAY ||  SHIELD_TOTEM_DONGLE_SNAKE ||  SHIELD_TOTEM_DONGLE_CAT

config ZMK_KEYBOARD_NAME
    default "TOTEM"

config ZMK_SPLIT_ROLE_CENTRAL
    default y

config ZMK_USB
    default y

# Set this to the number of peripherals your dongle will have.
# For a unibody, this would be 1. If you have left and right halves, set it to 2, etc.
config ZMK_SPLIT_BLE_CENTRAL_PERIPHERALS
    default 2

endif

if SHIELD_TOTEM_LEFT || SHIELD_TOTEM_RIGHT

config ZMK_SPLIT_ROLE_CENTRAL
    default n

endif
```

## boards/shields/totem-dongle/Kconfig.shield
```kconfig
# Copyright (c) 2023 The ZMK Contributors
# SPDX-License-Identifier: MIT

config SHIELD_TOTEM_LEFT
	def_bool $(shields_list_contains,totem_left)

config SHIELD_TOTEM_RIGHT
	def_bool $(shields_list_contains,totem_right)

config SHIELD_TOTEM_DONGLE
	def_bool $(shields_list_contains,totem_dongle)

config SHIELD_TOTEM_DONGLE_PROSPECTOR
	def_bool $(shields_list_contains,totem_dongle_prospector)

config SHIELD_TOTEM_DONGLE_SNAKE
	def_bool $(shields_list_contains,totem_dongle_snake)

config SHIELD_TOTEM_DONGLE_CAT
	def_bool $(shields_list_contains,totem_dongle_cat)
```

## config/west.yml
```yaml
manifest:
  remotes:
    - name: zmkfirmware
      url-base: https://github.com/zmkfirmware
    - name: urob
      url-base: https://github.com/urob
    - name: carrefinho
      url-base: https://github.com/bukharovsi
    - name: janpfischer
      url-base: https://github.com/janpfischer
    - name: joaopedropio                          # <--- add these
      url-base: https://github.com/joaopedropio   # <---
  projects:
    - name: zmk
      remote: zmkfirmware
      revision: main
      import: app/west.yml
    - name: zmk-helpers
      remote: urob
      revision: main
    - name: prospector-zmk-module
      remote: carrefinho
      revision: main
    - name: zmk-dongle-screen
      remote: janpfischer
      revision: main
     - name: snake-module                          # <--- and these
      remote: joaopedropio                        # <---
      revision: master                            # <---
  self:
    path: config
```
